#include "Robottino.h"

#define BUZZ_PIN 13
#define RED_PIN 11
#define GRN_PIN 10
#define BLU_PIN 9
#define SERVO_PIN 8
#define TRIG_PIN 7
#define ECHO_PIN 4
#define LDR_DX_PIN A0
#define LDR_SX_PIN A1

#define ANGLE_STEP 1
#define ANGLE_BOUND 40

#define THRESHOLD1 600  // used when controlling the speed with light intensity
#define THRESHOLD2 300


//RGB fade timing
#define STEP_DURATION 100        // since one display refresh takes around 110 ms while reading the sensors' values, this delay is larger to avoid any influence
#define HOLD_DURATION 0        // Optional hold when a color is complete, before the next crossFade
#define STEP_WIDTH 10
#define TOTAL_STEPS 240

#define DISPLAY_DELAY 100

SoftwareServo servo;


// ----------RGB (Nose) behaviour definition----------

// Color arrays
int nero[3]  = { 0, 0, 0 };		//black
int bianco[3]  = { 240, 240, 240 };	//white
int rosso[3]    = { 240, 0, 0 };	//red
int arancio[3] = { 240, 120, 0};	//orange
int giallo[3] = { 120, 240, 0 };	//yellow
int verde[3]  = { 0, 240, 0 };		//green
int blu[3]   = { 0, 0, 240 };		// blu
int indaco[3] = { 120, 0, 120 };	//indigo
int viola[3] = { 240, 120, 240 };	//purple
int arcobaleno[3] = { -1, 0, 0};	//rainbow (Needs a workaround because of compatibility problems between PWN on pin 11 and the tone() function)

// Set initial color
int redVal = nero[0];
int grnVal = nero[1];
int bluVal = nero[2];

// Initialize color variables
int prevR = redVal;
int prevG = grnVal;
int prevB = bluVal;

unsigned long currentRGBMillis;       // used to control the fading speed of the rainbow
unsigned long previousRGBMillis = 0;

unsigned long currentBlinkMillis;     // used in "nasoLampeggiante"
unsigned long previousBlinkMillis = 0;

byte evalFadeHold = 0;            // 0: evaluate parameters - 1: fade - 2: hold
int RGBStep = 0;                  // index used during the progress of "crossFade"
int R, G, B;                      // RGB values to reach at the end of a "crossFade"
int stepR, stepG, stepB;          // from the beginning to the end of a "crossFade" each colour is changed every step"X"
byte currentColour = 3;           // index used during the progress of "naso(arcobaleno)", see the function to see why it starts from 3
bool blinkStep = 0;

void RGBInit() {
  pinMode(RED_PIN, OUTPUT);
  pinMode(GRN_PIN, OUTPUT);
  pinMode(BLU_PIN, OUTPUT);
}

// Evaluate the width of a step based on the actual value end the one to reach, for a single light component (R, G or B)
// The value returned can be negative, so byte data type cannot be used
int calculateStep (int prevValue, int endValue) {
  int step = (endValue - prevValue)/STEP_WIDTH;
  if (step) {                     // If its non-zero
    step = TOTAL_STEPS/step;              // In the worst case (0->255) the brightness is adjusted each step
  }
  return step;
}

// Evaluate the actual light component value
int calculateVal(int step, int val, int counter) {
  if ((step) && counter % step == 0) {    // If step is non-zero and its time to change a value,
    if (step > 0 && val <= 255 - STEP_WIDTH) {    //   increment the value if step is positive and not next to maximum...
      val += STEP_WIDTH;
    }
    else if (step < 0 && val >= 0 + STEP_WIDTH) { //   ...or decrement it if step is negative and not next to 0
      val -= STEP_WIDTH;
    }
  }
  return val;
}


void crossFade(int color[3]) {
  currentRGBMillis = millis();

  if (evalFadeHold == 0) {
    //R = color[0];
    G = color[1];
    B = color[2];
    //stepR = calculateStep(prevR, R);
    stepG = calculateStep(prevG, G);
    stepB = calculateStep(prevB, B);

    evalFadeHold = 1;
  }

  else if (currentRGBMillis - previousRGBMillis >= STEP_DURATION && evalFadeHold==1) {  // Fade

    //redVal = calculateVal(stepR, redVal, RGBStep);
    grnVal = calculateVal(stepG, grnVal, RGBStep);
    bluVal = calculateVal(stepB, bluVal, RGBStep);

    //analogWrite(RED_PIN, redVal);     // the tone() function conflicts with PWM on pin 11 (RED), so to avoid weird noises we do not use RED fading
    analogWrite(GRN_PIN, grnVal);
    analogWrite(BLU_PIN, bluVal);

    previousRGBMillis = currentRGBMillis;
    RGBStep+=STEP_WIDTH;

    if( RGBStep >= TOTAL_STEPS ) {
      evalFadeHold = 2;
      RGBStep = 0;
    }
  }

  // Update current values for next loop
  else if (currentRGBMillis - previousRGBMillis >= HOLD_DURATION && evalFadeHold==2) {  // Hold
    prevR = redVal;
    prevG = grnVal;
    prevB = bluVal;
    previousRGBMillis = currentRGBMillis;
    evalFadeHold = 0;

    currentColour ++;
  }
}

// Rainbow


void Robottino::naso (int col[3]) {	//naso = nose
  if (col[0] == -1) {  // Rainbow
    switch (currentColour) {  // since we can't use the red LED, we won't show colours mainly composed of that kind of light
      /*
      case 0:
        crossFade(rosso);
        break;
      case 1:
        crossFade(arancio);
        break;
      case 2:
        crossFade(giallo);
        break;
        */
      case 3:
        crossFade(verde);
        break;
      case 4:
        crossFade(blu);
        break;
      case 5:
        crossFade(viola);
        break;
      default:
        currentColour = 3;
    }
  }
  else {    // Fixed colours
    analogWrite(RED_PIN, col[0]);
    analogWrite(GRN_PIN, col[1]);
    analogWrite(BLU_PIN, col[2]);
  }
}

void Robottino::nasoLampeggiante (int col[3], int interval) {  //nasoLampeggiante = blinkingNose
  currentBlinkMillis = millis();
  if (currentBlinkMillis - previousBlinkMillis >= interval) {
    if (!blinkStep) {       // Alternate between the wanted colour...
      naso(col);
      blinkStep ^= 1;
    }
    else {
      naso(nero); // ... and a turned off LED
      blinkStep ^= 1;
    }
    previousBlinkMillis = currentBlinkMillis;
  }
}


// ----------Sensors behaviour definition----------

void sensorsInit() {
  pinMode(LDR_DX_PIN, INPUT);
  pinMode(LDR_SX_PIN, INPUT);
  pinMode(TRIG_PIN, OUTPUT);
  pinMode(ECHO_PIN, INPUT);
}


// ----------Eyes----------
int distanzaRilevata;
unsigned long previousSonicMillis = 0;

// Returns distance in cm
int Robottino::leggiDistanza () {               //can't use newPing library because of compatibility problems with tone() on Arduino UNO
  if (millis() - previousSonicMillis > 50) {
    digitalWrite(TRIG_PIN, HIGH);   //(see: http://forum.arduino.cc/index.php?topic=184162.0 )
    delay(1);
    digitalWrite(TRIG_PIN, LOW);
    int distance = pulseIn(ECHO_PIN, HIGH, 5700) / 57;  //Timeout if distance > 100 cm; divide by round-trip microseconds per cm to get cm
    distanzaRilevata = distance;
    previousSonicMillis = millis();
  }
  return distanzaRilevata;
}

byte distanceThreshold = 10;

bool oggettoVicino () {
  Serial.println(distanzaRilevata);
  if (distanzaRilevata < distanceThreshold && distanzaRilevata != 0) return 1;
  else return 0;
}

int luceRilevata;

int Robottino::leggiLuce(byte sensor) {
  int sensorValue;
  if (sensor == antennaDestra) {
      sensorValue = analogRead(LDR_DX_PIN);
    }
  else if (sensor == antennaSinistra) {
    sensorValue = analogRead(LDR_SX_PIN);
  }
  else if (sensor == antenne) {
    sensorValue = (analogRead(LDR_DX_PIN)+analogRead(LDR_SX_PIN))/2;
  }
  luceRilevata = sensorValue;
  return sensorValue;
}

int lightThreshold = 400;

bool luceAccesa() {
  if (luceRilevata>lightThreshold) return 1; // I didn't succeed into using leggiLuce here...
  else return 0;
}

// ----------Display (Mouth) behaviour definition----------

U8GLIB_SSD1306_128X64 u8g(U8G_I2C_OPT_NONE|U8G_I2C_OPT_DEV_0);  // I2C / TWI

unsigned long currentDisplayMillis;
unsigned long previousDisplayMillis = 0;

byte occhi = 1;			//eyes
byte antennaDestra = 2;		//rightPhotoResistor
byte antennaSinistra = 3;	//leftPhotoResistor
byte antenne = 4;		//both PhotoResistors

uint8_t * previousFace = NULL;

// Draw different kinds of facial expressions on the display
void Robottino::espressione(const uint8_t mouthStyle[]) {	// shows a facial expression on the OLED display
  currentDisplayMillis = millis();
  if (mouthStyle == previousFace) {
    return;
  }
  else if (currentDisplayMillis - previousDisplayMillis >= DISPLAY_DELAY) {
    u8g.firstPage();
    do {
      u8g.drawBitmapP(0, 0, 16, 64, mouthStyle);
    } while( u8g.nextPage() );
    previousFace = (uint8_t *) mouthStyle;
    previousDisplayMillis = currentDisplayMillis;
  }
}


// Print values read by the sensors with a bar indicator
void Robottino::mostra (byte sensor) {  // it takes around 110 ms to complete with the reading from any of the sensors
  unsigned int sensorValue, normalizedValue;

  if (sensor == occhi) {
    sensorValue = leggiDistanza();
    normalizedValue = sensorValue;  // no need to normalize because the limit is set to 100 cm
  }
  else {
    sensorValue = leggiLuce(sensor)/100;
    normalizedValue = sensorValue * 12; // max sensorValue is 100, so we multiply to use all the width
  }

  currentDisplayMillis = millis();
  if (currentDisplayMillis - previousDisplayMillis >= DISPLAY_DELAY) { // with these lines commented out, display refreshed each time the function is called
    u8g.firstPage();
    do {
      u8g.setFont(u8g_font_unifont);
      u8g.setPrintPos( 55, 20);
      u8g.print(sensorValue);
      u8g.drawBox(64 - normalizedValue/2, 40, normalizedValue, 10);  //start from the middle to center the box
    } while( u8g.nextPage() );
    previousDisplayMillis = currentDisplayMillis;
  }
}


int pitch;
unsigned long currentBuzzTime;
unsigned long previousBuzzTime = 0;
const byte thereminDelay = 10;

void buzzInit () {
  pinMode(BUZZ_PIN, OUTPUT);
}

void Robottino::theremin(byte sensor) {  // without any calibration
  currentBuzzTime = millis();
  if (currentBuzzTime - previousBuzzTime >= thereminDelay) {
    if (sensor == antenne) {
      pitch = map((analogRead(LDR_DX_PIN)+analogRead(LDR_SX_PIN))/2, 0, 1024, 40, 4000);
    }
    else if (sensor == occhi) {
      pitch = map(leggiDistanza(), 0, 50, 40, 4000);  // if the sensors are the LDR, the value can be as large as 1024
    }
    tone(BUZZ_PIN, pitch, 20);
    previousBuzzTime = currentBuzzTime;
  }
}

int silenzio = 0;
int allarme = 1000;

void Robottino::beep (int interval) {
  currentBuzzTime = millis();
  if (interval == silenzio) {
    digitalWrite(BUZZ_PIN, LOW);
  }
  else if (currentBuzzTime - previousBuzzTime >= interval) {
    tone(BUZZ_PIN, NOTE_DS7, 20);     // this note is in the range that produces the maximum amplitude
    previousBuzzTime = currentBuzzTime;
  }
}

//Mario main theme melody
int melody[] = {
  NOTE_E7, NOTE_E7, 0, NOTE_E7,
  0, NOTE_C7, NOTE_E7, 0,
  NOTE_G7, 0, 0,  0,
  NOTE_G6, 0, 0, 0,

  NOTE_C7, 0, 0, NOTE_G6,
  0, 0, NOTE_E6, 0,
  0, NOTE_A6, 0, NOTE_B6,
  0, NOTE_AS6, NOTE_A6, 0,

  NOTE_G6, NOTE_E7, NOTE_G7,
  NOTE_A7, 0, NOTE_F7, NOTE_G7,
  0, NOTE_E7, 0,NOTE_C7,
  NOTE_D7, NOTE_B6, 0, 0,

  NOTE_C7, 0, 0, NOTE_G6,
  0, 0, NOTE_E6, 0,
  0, NOTE_A6, 0, NOTE_B6,
  0, NOTE_AS6, NOTE_A6, 0,

  NOTE_G6, NOTE_E7, NOTE_G7,
  NOTE_A7, 0, NOTE_F7, NOTE_G7,
  0, NOTE_E7, 0,NOTE_C7,
  NOTE_D7, NOTE_B6, 0, 0
};
//Mario main them tempo
int tempo[] = {
  12, 12, 12, 12,
  12, 12, 12, 12,
  12, 12, 12, 12,
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  12, 12, 12, 12,
};

//
//Underworld melody
int underworld_melody[] = {
  NOTE_C4, NOTE_C5, NOTE_A3, NOTE_A4,
  NOTE_AS3, NOTE_AS4, 0,
  0,
  NOTE_C4, NOTE_C5, NOTE_A3, NOTE_A4,
  NOTE_AS3, NOTE_AS4, 0,
  0,
  NOTE_F3, NOTE_F4, NOTE_D3, NOTE_D4,
  NOTE_DS3, NOTE_DS4, 0,
  0,
  NOTE_F3, NOTE_F4, NOTE_D3, NOTE_D4,
  NOTE_DS3, NOTE_DS4, 0,
  0, NOTE_DS4, NOTE_CS4, NOTE_D4,
  NOTE_CS4, NOTE_DS4,
  NOTE_DS4, NOTE_GS3,
  NOTE_G3, NOTE_CS4,
  NOTE_C4, NOTE_FS4,NOTE_F4, NOTE_E3, NOTE_AS4, NOTE_A4,
  NOTE_GS4, NOTE_DS4, NOTE_B3,
  NOTE_AS3, NOTE_A3, NOTE_GS3,
  0, 0, 0
};
//Underwolrd tempo
int underworld_tempo[] = {
  12, 12, 12, 12,
  12, 12, 6,
  3,
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  3, 3, 3
};

void buzz(long frequency, long length) {
  //digitalWrite(BLU_PIN,HIGH);
  long delayValue = 1000000/frequency/2; // calculate the delay value between transitions
  //// 1 second's worth of microseconds, divided by the frequency, then split in half since
  //// there are two phases to each cycle
  long numCycles = frequency * length/ 1000; // calculate the number of cycles for proper timing
  //// multiply frequency, which is really cycles per second, by the number of seconds to
  //// get the total number of cycles to produce
  for (long i=0; i < numCycles; i++){ // for the calculated length of time...
    digitalWrite(BUZZ_PIN,HIGH); // write the buzzer pin high to push out the diaphram
    delayMicroseconds(delayValue); // wait for the calculated delay value
    digitalWrite(BUZZ_PIN,LOW); // write the buzzer pin low to pull back the diaphram
    delayMicroseconds(delayValue); // wait again or the calculated delay value
  }
  //digitalWrite(BLU_PIN,LOW);

}

void sing(int song) {
  // iterate over the notes of the melody:
  if(song==2) {
    int size = sizeof(underworld_melody) / sizeof(int);
    for (int thisNote = 0; thisNote < size; thisNote++) {

      // to calculate the note duration, take one second
      // divided by the note type.
      //e.g. quarter note = 1000 / 4, eighth note = 1000/8, etc.
      int noteDuration = 1000/underworld_tempo[thisNote];

      buzz(underworld_melody[thisNote],noteDuration);

      // to distinguish the notes, set a minimum time between them.
      // the note's duration + 30% seems to work well:
      int pauseBetweenNotes = noteDuration * 1.30;
      delay(pauseBetweenNotes);

      // stop the tone playing:
      buzz(0,noteDuration);

    }

  }
  else {
    int size = sizeof(melody) / sizeof(int);
    for (int thisNote = 0; thisNote < size; thisNote++) {

      // to calculate the note duration, take one second
      // divided by the note type.
      //e.g. quarter note = 1000 / 4, eighth note = 1000/8, etc.
      int noteDuration = 1000/tempo[thisNote];

      buzz(melody[thisNote],noteDuration);

      // to distinguish the notes, set a minimum time between them.
      // the note's duration + 30% seems to work well:
      int pauseBetweenNotes = noteDuration * 1.30;
      delay(pauseBetweenNotes);

      // stop the tone playing:
      buzz(0,noteDuration);

    }
  }
}

void Robottino::superMario()
{
  //sing the tunes
  sing(1);
  sing(1);
  sing(2);
}


int veloce = 10; // different delay between steps
int lento = 30;
int impazzito = 0;

int angle = 0;  // reference given to the initial position, which is set in servoInit to 90 degrees
int dir = 1;    // direction of rotation

int multiplier=0, average, stepDelay;

unsigned long currentServoMillis;
unsigned long previousServoMillis = 0;

void servoInit () {
  servo.attach(SERVO_PIN);
  servo.write(90);
  SoftwareServo::refresh();
  delay(30);    // wait for the servo to reach that position
  SoftwareServo::refresh();
}

bool Robottino::ruota (int stepDelay) { // uses the servo to rotate on itself
  currentServoMillis = millis();
  if (currentServoMillis - previousServoMillis >= stepDelay) {

    if (angle < - ANGLE_BOUND || angle > ANGLE_BOUND) {
      dir = -dir;
    }
    angle += dir * ANGLE_STEP;

    servo.write (angle + 90);

    previousServoMillis = currentServoMillis;
  }
  SoftwareServo::refresh();	// Servo needs to be refreshed each 50ms with this library, this is not guaranteed  with this line, since we dont exactly know time length of one loop in the Arduino code
  if (angle >= ANGLE_BOUND || angle <= - ANGLE_BOUND) return 1;
  else return 0;
}

void Robottino::ruotaConLuce () { // rotates faster and displays a scared face with maximum lighting conditions, with the sensors covered displays an happy face and does not rotate, otherwise an average behaviour is played
  currentServoMillis = millis();


  if (currentServoMillis - previousServoMillis >= 25) {
	  average = (analogRead(LDR_SX_PIN) + analogRead(LDR_DX_PIN)) / 2;
	  if (average < THRESHOLD2)
	  {
		  if (multiplier != 0)
		  {
			  this->espressione(happy);
			  this->naso(verde);
		  }
		  multiplier = 0;
	  }
	  else if (average < THRESHOLD1) {
		  if (multiplier != 1)
		  {
			this->espressione(sad);
			this->naso(viola);
		  }
		  multiplier = 1;

	  }
	  else	if (multiplier != 5) {

		  this->espressione(scared);
		  this->naso(rosso);
		  multiplier = 5;
	  }
	 if (angle < -ANGLE_BOUND || angle > ANGLE_BOUND) {
		  dir = -dir;
	  }

	  angle += dir * ANGLE_STEP * multiplier;
	  servo.write(angle + 90);
	  previousServoMillis = currentServoMillis;
  }
  SoftwareServo::refresh();
}

void Robottino::posiziona (int angle) { // from +180 to -180 with respect to the center (actually the range is narrower)
  servo.write(angle+90);
  SoftwareServo::refresh();
}

void Robottino::begin() {
  RGBInit();

  sensorsInit();

  buzzInit();

  servoInit();

  u8g.firstPage();  // turns the display black at power on
  do {
    u8g.drawBitmapP(0, 0, 16, 64, vuota);
  } while( u8g.nextPage() );
}

Robottino::Robottino() {

}



// ----------Facial expressions----------

const uint8_t vuota[] PROGMEM = {
  0x00, 0x00, 0x00, 0x00, 0x00, 0x00, 0x00, 0x00, 0x00, 0x00, 0x00, 0x00, 0x00, 0x00, 0x00, 0x00,
  0x00, 0x00, 0x00, 0x00, 0x00, 0x00, 0x00, 0x00, 0x00, 0x00, 0x00, 0x00, 0x00, 0x00, 0x00, 0x00,
  0x00, 0x00, 0x00, 0x00, 0x00, 0x00, 0x00, 0x00, 0x00, 0x00, 0x00, 0x00, 0x00, 0x00, 0x00, 0x00,
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  0x00, 0x00, 0x00, 0x00, 0x00, 0x00, 0x00, 0x00, 0x00, 0x00, 0x00, 0x00, 0x00, 0x00, 0x00, 0x00
};

const uint8_t neutra[] PROGMEM = {
  0x00, 0x00, 0x00, 0x00, 0x00, 0x00, 0x00, 0x00, 0x00, 0x00, 0x00, 0x00, 0x00, 0x00, 0x00, 0x00,
  0x00, 0x00, 0x00, 0x00, 0x00, 0x00, 0x00, 0x00, 0x00, 0x00, 0x00, 0x00, 0x00, 0x00, 0x00, 0x00,
  0x00, 0x00, 0x00, 0x00, 0x00, 0x00, 0x00, 0x00, 0x00, 0x00, 0x00, 0x00, 0x00, 0x00, 0x00, 0x00,
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  0x00, 0x00, 0x00, 0x00, 0x00, 0x00, 0x00, 0x00, 0x00, 0x00, 0x00, 0x00, 0x00, 0x00, 0x00, 0x00
  };

const uint8_t felice[] PROGMEM = {
  0x0F, 0xFF, 0xFF, 0xFF, 0xFF, 0xFF, 0xFF, 0xFF, 0xFF, 0xFF, 0xFF, 0xFF, 0xFF, 0xFF, 0xFF, 0xF0,
  0x3F, 0xFF, 0xFF, 0xFF, 0xFF, 0xFF, 0xFF, 0xFF, 0xFF, 0xFF, 0xFF, 0xFF, 0xFF, 0xFF, 0xFF, 0xFC,
  0x7F, 0xFF, 0xFF, 0xFF, 0xFF, 0xFF, 0xFF, 0xFF, 0xFF, 0xFF, 0xFF, 0xFF, 0xFF, 0xFF, 0xFF, 0xFE,
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  0x00, 0x00, 0x00, 0x00, 0x00, 0x00, 0x00, 0x00, 0x00, 0x00, 0x00, 0x00, 0x00, 0x00, 0x00, 0x00
  };

const uint8_t spaventato[] PROGMEM = {
  0x00, 0x00, 0x00, 0x00, 0x00, 0x00, 0x00, 0x00, 0x00, 0x00, 0x00, 0x00, 0x00, 0x00, 0x00, 0x00,
  0x00, 0x00, 0x00, 0x00, 0x00, 0x00, 0x00, 0x00, 0x00, 0x00, 0x00, 0x00, 0x00, 0x00, 0x00, 0x00,
  0x00, 0x00, 0x00, 0x00, 0x00, 0x00, 0x00, 0x00, 0x00, 0x00, 0x00, 0x00, 0x00, 0x00, 0x00, 0x00,
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  0x00, 0x00, 0x00, 0x00, 0x00, 0x00, 0x00, 0x00, 0x00, 0x00, 0x00, 0x00, 0x00, 0x00, 0x00, 0x00
  };

const uint8_t fablabLogo[] PROGMEM = {
  0x00, 0x00, 0x00, 0x00, 0x00, 0x00, 0x00, 0x00, 0x00, 0x00, 0x00, 0x00, 0x00, 0x00, 0x00, 0x00,
  0x00, 0x00, 0x00, 0x00, 0x00, 0x00, 0x00, 0x0F, 0xF8, 0x00, 0x00, 0x00, 0x00, 0x00, 0x00, 0x00,
  0x00, 0x00, 0x00, 0x00, 0x00, 0x00, 0x00, 0xFF, 0xFF, 0x80, 0x00, 0x00, 0x00, 0x00, 0x00, 0x00,
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  0x00, 0x00, 0x00, 0x00, 0x00, 0x00, 0x00, 0x00, 0x00, 0x00, 0x00, 0x00, 0x00, 0x00, 0x00, 0x00
  };

const uint8_t robottinoLogo[] PROGMEM = {
  0x00, 0x00, 0x00, 0x00, 0x00, 0x00, 0x00, 0x00, 0x00, 0x00, 0x00, 0x00, 0x00, 0x00, 0x00, 0x00,
  0x00, 0x00, 0x00, 0x00, 0x00, 0x00, 0x00, 0x00, 0x00, 0x00, 0x00, 0x00, 0x00, 0x00, 0x00, 0x00,
  0x00, 0x00, 0x00, 0x00, 0x00, 0x00, 0x00, 0x00, 0x00, 0x00, 0x00, 0x00, 0x00, 0x00, 0x00, 0x00,
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  0x00, 0x00, 0x00, 0x00, 0x00, 0x00, 0x00, 0x00, 0x00, 0x00, 0x00, 0x00, 0x00, 0x00, 0x00, 0x00
  };

// to be verified with Giovanni
const uint8_t normale[] PROGMEM = {
  0x00, 0x00, 0x00, 0x00, 0x00, 0x00, 0x00, 0x00, 0x00, 0x00, 0x00, 0x00, 0x00, 0x00, 0x00, 0x00,
  0x00, 0x00, 0x00, 0x00, 0x00, 0x00, 0x00, 0x00, 0x00, 0x00, 0x00, 0x00, 0x00, 0x00, 0x00, 0x00,
  0x00, 0x00, 0x00, 0x00, 0x00, 0x00, 0x00, 0x00, 0x00, 0x00, 0x00, 0x00, 0x00, 0x00, 0x00, 0x00,
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  0x00, 0x00, 0x00, 0x00, 0x00, 0x00, 0x00, 0x00, 0x00, 0x00, 0x00, 0x00, 0x00, 0x00, 0x00, 0x00
};

const uint8_t angry[] PROGMEM = {

	0xFF, 0xFF, 0xFF, 0xFF, 0xFF, 0xFF, 0xFF, 0xFF, 0xFF, 0xFF, 0xFF, 0xFF, 0xFF, 0xFF, 0xFF, 0xFF,
	0xFF, 0xFF, 0xFF, 0xFF, 0xFF, 0xFF, 0xFF, 0xFF, 0xFF, 0xFF, 0xFF, 0xFF, 0xFF, 0xFF, 0xFF, 0xFF,
	0xFF, 0xFF, 0xFF, 0xFF, 0xFF, 0xFF, 0xFF, 0xFF, 0xFF, 0xFF, 0xFF, 0xFF, 0xFF, 0xFF, 0xFF, 0xFF,
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	0xFF, 0xFF, 0xFF, 0xFF, 0xFF, 0xFF, 0xFF, 0xFF, 0xFF, 0xFF, 0xFF, 0xFF, 0xFF, 0xFF, 0xFF, 0xFF
};

const uint8_t trollface[] PROGMEM = {

	0xFF, 0xFF, 0xFF, 0xFF, 0xFF, 0xF0, 0x00, 0x00, 0xFF, 0xFF, 0xFF, 0xFF, 0xFF, 0xFF, 0xFF, 0xFF,
	0xFF, 0xFF, 0xFF, 0xFF, 0xFF, 0x80, 0xFF, 0x80, 0x00, 0x3F, 0xFF, 0xFF, 0xFF, 0xFF, 0xFF, 0xFF,
	0xFF, 0xFF, 0xFF, 0xFF, 0xFE, 0x3F, 0xFF, 0xFF, 0xFE, 0x00, 0x3F, 0xFF, 0xFF, 0xFF, 0xFF, 0xFF,
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	0xFF, 0xFF, 0xFF, 0xFF, 0xFF, 0xFF, 0xFF, 0xFF, 0xFF, 0xE0, 0x00, 0xFF, 0xFF, 0xFF, 0xFF, 0xFF
};

const uint8_t scared[] PROGMEM = {
	0xFF, 0xFF, 0xFF, 0xFF, 0xFF, 0xFF, 0xFF, 0xFF, 0xFF, 0xFF, 0xFF, 0xFF, 0xFF, 0xFF, 0xFF, 0xFF,
	0xFF, 0xFF, 0xFF, 0xFF, 0xFF, 0xFF, 0xFF, 0xFF, 0xFF, 0xFF, 0xFF, 0xFF, 0xFF, 0xFF, 0xFF, 0xFF,
	0xFF, 0xFF, 0xFF, 0xFF, 0xFF, 0xFF, 0xFF, 0xFF, 0xFF, 0xFF, 0xFF, 0xFF, 0xFF, 0xFF, 0xFF, 0xFF,
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	0xFF, 0xFF, 0xFF, 0xFF, 0xFF, 0xFF, 0xFF, 0xFF, 0xFF, 0xFF, 0xFF, 0xFF, 0xFF, 0xFF, 0xFF, 0xFF
};

const uint8_t smile[] PROGMEM = {

	0xFF, 0xFF, 0xFF, 0xFF, 0xFF, 0xFF, 0xFF, 0xFF, 0xFF, 0xFF, 0xFF, 0xFF, 0xFF, 0xFF, 0xFF, 0xFF,
	0xFF, 0xFF, 0xFF, 0xFF, 0xFF, 0xFF, 0xFF, 0xFF, 0xFF, 0xFF, 0xFF, 0xFF, 0xFF, 0xFF, 0xFF, 0xFF,
	0xFF, 0xFF, 0xFF, 0xFF, 0xFF, 0xFF, 0xFF, 0xFF, 0xFF, 0xFF, 0xFF, 0xFF, 0xFF, 0xFF, 0xFF, 0xFF,
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	0xFF, 0xFF, 0xFF, 0xFF, 0xFF, 0xFF, 0xFF, 0xFF, 0xFF, 0xFF, 0xFF, 0xFF, 0xFF, 0xFF, 0xFF, 0xFF
};

const uint8_t dumb[] PROGMEM = {
	0xFF, 0xFF, 0xFF, 0xFF, 0xFF, 0xFF, 0xFF, 0xFF, 0xFF, 0xFF, 0xFF, 0xFF, 0xFF, 0xFF, 0xFF, 0xFF,
	0xFF, 0xFF, 0xFF, 0xFF, 0xFF, 0xFF, 0xFF, 0xF0, 0x03, 0xFF, 0xFF, 0xFF, 0xFF, 0xFF, 0xFF, 0xFF,
	0xFF, 0xFF, 0xFF, 0xFF, 0xFF, 0xFF, 0xFE, 0x1F, 0xFC, 0xFF, 0xFF, 0xFF, 0xFF, 0xFF, 0xFF, 0xFF,
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	0xFF, 0xFF, 0xFF, 0xFF, 0xFD, 0xFF, 0xFF, 0xFC, 0x07, 0xFF, 0xF7, 0xFF, 0xFF, 0xFF, 0xFF, 0xFF
};

const uint8_t bleh[] PROGMEM = {
	0xFF, 0xFF, 0xFF, 0xFF, 0xFF, 0xFF, 0xFF, 0xFF, 0xFF, 0xFF, 0xFF, 0xFF, 0xFF, 0xFF, 0xFF, 0xFF,
	0xFF, 0xFF, 0xFF, 0xFF, 0xFF, 0xFF, 0xFF, 0xFF, 0xFF, 0xFF, 0xFF, 0xFF, 0xFF, 0xFF, 0xFF, 0xFF,
	0xFF, 0xFF, 0xFF, 0xFF, 0xFF, 0xFF, 0xFF, 0xFF, 0xFF, 0xFF, 0xFF, 0xFF, 0xFF, 0xFF, 0xFF, 0xFF,
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	0xFF, 0xFF, 0xFF, 0xFF, 0xFF, 0xFF, 0xFF, 0xFF, 0xFF, 0xFF, 0xFF, 0xFF, 0xFF, 0xFF, 0xFF, 0xFF
};

const uint8_t sad [] PROGMEM = {
	0xFF, 0xFF, 0xFF, 0xFF, 0xFF, 0xFF, 0xFF, 0xFF, 0xFF, 0xFF, 0xFF, 0xFF, 0xFF, 0xFF, 0xFF, 0xFF,
	0xFF, 0xFF, 0xFF, 0xFF, 0xFF, 0xFF, 0xFF, 0xFF, 0xFF, 0xFF, 0xFF, 0xFF, 0xFF, 0xFF, 0xFF, 0xFF,
	0xFF, 0xFF, 0xFF, 0xFF, 0xFF, 0xFF, 0xFF, 0xFF, 0xFF, 0xFF, 0xFF, 0xFF, 0xFF, 0xFF, 0xFF, 0xFF,
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	0xFF, 0xFF, 0xFF, 0xFF, 0xFF, 0xFF, 0xFF, 0xFF, 0xFF, 0xFF, 0xFF, 0xFF, 0xFF, 0xFF, 0xFF, 0xFF
};

const uint8_t happy [] PROGMEM= {
	0xFF, 0xFF, 0xFF, 0xFF, 0xFF, 0xFF, 0xFF, 0xFF, 0xFF, 0xFF, 0xFF, 0xFF, 0xFF, 0xFF, 0xFF, 0xFF,
	0xFF, 0xFF, 0xFF, 0xFF, 0xFF, 0xFF, 0xFF, 0xFF, 0xFF, 0xFF, 0xFF, 0xFF, 0xFF, 0xFF, 0xFF, 0xFF,
	0xFF, 0xFF, 0xFF, 0xFF, 0xFF, 0xFF, 0xFF, 0xFF, 0xFF, 0xFF, 0xFF, 0xFF, 0xFF, 0xFF, 0xFF, 0xFF,
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	0xFF, 0xFF, 0xFF, 0xFF, 0xFF, 0xFF, 0xFF, 0xFF, 0xFF, 0xFF, 0xFF, 0xFF, 0xFF, 0xFF, 0xFF, 0xFF
};
